## configs/gateway3df_uboot_defconfig
```kconfig
CONFIG_SAMA5D3X=y
CONFIG_CPU_CLK_528MHZ=y
CONFIG_DEBUG=y
CONFIG_DDR_SET_BY_DEVICE=y
CONFIG_DDR_MT47H128M16=y
CONFIG_NOT_DQS_DISABLED=y
CONFIG_IMG_ADDRESS="0x00030000"
CONFIG_IMG_SIZE="0x00100000"
# CONFIG_DISABLE_WATCHDOG is not set
CONFIG_BOARD_QUIRK_SAMA5D3=y
CONFIG_BOARD_QUIRK_GATEWAY3=y
CONFIG_LED_ON_BOARD=y
CONFIG_LED_R_ON_PIOA=y
CONFIG_LED_R_PIN=20
CONFIG_LED_R_VALUE=1
CONFIG_LED_G_ON_PIOA=y
CONFIG_LED_G_PIN=22
CONFIG_LED_G_VALUE=0
CONFIG_LED_B_ON_PIOD=y
CONFIG_LED_B_PIN=5
```
